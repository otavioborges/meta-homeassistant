## conf/layer.conf
```bitbake
# We might have a conf and classes directory, append to BBPATH
BBPATH .= ":${LAYERDIR}"

# We have recipes directories, add to BBFILES
BBFILES += "${LAYERDIR}/recipes*/*/*.bb ${LAYERDIR}/recipes*/*/*.bbappend"

BBFILE_COLLECTIONS += "meta-homeassistant"
BBFILE_PATTERN_meta-homeassistant := "^${LAYERDIR}/"
BBFILE_PRIORITY_meta-homeassistant = "6"

# This should only be incremented on significant changes that will
# cause compatibility issues with other layers
LAYERVERSION_meta-homeassistant = "1"

LAYERDEPENDS_meta-homeassistant = "core (>= 12) meta-python"

LAYERSERIES_COMPAT_meta-homeassistant = "nanbield"

LICENSE_PATH += "${LAYERDIR}/licenses"
```
